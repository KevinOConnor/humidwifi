## fw/main/Kconfig.projbuild
```kconfig
menu "Application settings for 'humidity wifi' project"

    config MEASURE_INTERVAL
        int "Time between measurements (in seconds)"
        default 300

    config UPLOAD_INTERVAL
        int "Time between uploads (in seconds)"
        default 900

    config MAX_RUN_TIME
        int "Maximum time (in seconds) before aborting measurement/upload"
        default 5

    config MAX_OTA_TIME
        int "Maximum time (in seconds) before aborting ota flash update"
        default 300

    menu "Battery check"

    config BATTERY_CHANNEL
        int "ADC2 Channel to measure battery voltage on"
        default 3

    config BATTERY_SCALE
        string "Battery voltage scale"
        default "2.0"
        help
            Amount to scale the battery voltage measurements to
            account for per-board differences in adc and resistors.

    config BATTERY_OFFSET
        string "Battery voltage offset"
        default "0.089"
        help
            Actual voltage when the adc unit reports zero. The esp-idf
            framework defaults to 0.089V for adc2 measurements with
            "6db attenuation". A custom per-board setting may be
            specified.

    config BATTERY_CUTOFF
        string "Voltage cutoff"
        default "2.9"
        help
            Minimum voltage before chip ceases taking measurements.

    endmenu

    menu "BME280"

    config BME280_I2C_ADDR
        hex "I2C address of BME280 chip"
        default 0x77

    config BME280_SDA_GPIO
        int "GPIO pin number of the line connected to BME280 SDA pin"
        default 22

    config BME280_SCL_GPIO
        int "GPIO pin number of the line connected to BME280 SCL pin"
        default 23

    endmenu

    menu "Networking configuration"

    config WIFI_SSID
        string "WiFi SSID"
        default "myssid"
        help
            SSID (network name) for the example to connect to.

    config WIFI_PASSWORD
        string "WiFi Password"
        default "mypassword"
        help
            WiFi password (WPA or WPA2) for the example to use.
            Can be left blank if the network has no security set.

    config BROKER_URL
        string "Broker URL"
        default "mqtt://mqtt.eclipse.org"
        help
            URL of the broker to connect to

    config MQTT_TOPIC_PREFIX
        string "Prefix to use for MQTT topic"
        default "topic"

    config DHCP_LEASE_HOURS
        int "Number of hours to keep DHCP lease"
        default 48
        help
            Set to zero to request IP information (via DHCP) on every
            connection.  Setting this to a non-zero value will cause
            previously obtained IP information to be used on future
            connections.

            Enabling this option significantly reduces the time it
            takes to establish a wifi connection which improves
            battery usage.

    endmenu

endmenu
```

## fw/sdkconfig.defaults
```kconfig
CONFIG_ESPTOOLPY_FLASHSIZE_4MB=y
CONFIG_PARTITION_TABLE_CUSTOM=y
CONFIG_OTA_ALLOW_HTTP=y   ### XXX

CONFIG_BOOTLOADER_SKIP_VALIDATE_IN_DEEP_SLEEP=y  ### only in v4.1
CONFIG_BOOTLOADER_LOG_LEVEL_WARN=y
CONFIG_ESP32_DEFAULT_CPU_FREQ_240=y

CONFIG_LOG_DEFAULT_LEVEL_WARN=y
CONFIG_LOG_COLORS=n
```
